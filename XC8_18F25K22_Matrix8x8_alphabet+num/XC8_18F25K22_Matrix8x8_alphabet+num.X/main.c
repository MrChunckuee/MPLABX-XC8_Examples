/*******************************************************************************
 *
 *                  Matriz de LEDs 8x8: Mostrar abecedario y numeros
 *
 *******************************************************************************
 * FileName:        main.c
 * Processor:       PIC18F25K22
 * Complier:        XC8 v1.42 & MPLAB X IDE v3.61
 * Author:          Pedro SАnchez (MrChunckuee)
 * Blog:            http://mrchunckuee.blogspot.com/
 * Email:           mrchunckuee.psr@gmail.com
 * Description:     Rutina sencilla para mostrar el abecedario y los numeros
 *******************************************************************************
 * Rev.         Date            Comment
 *   v1.00      28/06/2017      CreaciСn del ejemplo
 ******************************************************************************/
#include <xc.h>
#include <stdbool.h>
#include "FUSES_Config.h" //Only here

#define _XTAL_FREQ  16000000

// Define Alphabets A through Z
const unsigned int Alphabets[]={
    0x00, 0x3F, 0x7F, 0xE4, 0xE4, 0x7F, 0x3F, 0x00, //A
    0x00, 0xFF, 0xFF, 0x99, 0x99, 0xFF, 0x66, 0x00, //B
    0x00, 0x3C, 0x7E, 0xC3, 0x81, 0xC3, 0x42, 0x00, //C
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    0x00, 0xC7, 0xCF, 0xDB, 0xDB, 0xF3, 0xE3, 0x00 // Z
    };

//Define numbers 0 to 9
const unsigned int Numbers[] ={
    0x00, 0x7E, 0xFF, 0xCB, 0xD3, 0xFF, 0x7E, 0x00, //0
    0x00, 0x01, 0x61, 0xFF, 0xFF, 0x01, 0x01, 0x00, //1
    0x00, 0x66, 0xCF, 0xCB, 0xD3, 0xF3, 0x62, 0x00, //2
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    0x00, 0x70, 0xF8, 0x88, 0x88, 0xFF, 0x7F, 0x00  //9
    };

unsigned int count, column, num, repeat;

void MCU_Init(void);

void main(void) {
    MCU_Init(); //Inicializamos sistema
    while(true){
        // Display 26 alphabets
        for (num=0; num<26; num++) {
            for (repeat=0; repeat<100; repeat++){
                column = 1;
                for(count=num*8; count<(num*8+9); count++){
                    PORTB = Alphabets[count];
                    PORTC = column;
                    __delay_ms(1);
                    column = column<<1;
                }
            }
        }
        // Display 10 numbers
        for (num=0; num<10; num++) {
            for (repeat=0; repeat<100; repeat++){
                column = 1;
                for(count=num*8; count<(num*8+9); count++){
                    PORTB = Numbers[count];
                    PORTC = column;
                    __delay_ms(1);
                    column = column<<1;
                }
            }
        }
    }
}

void MCU_Init(void){
    //Puertos digitales
    ANSELA = 0;
    ANSELB = 0;
    ANSELC = 0;
    //Configura oscilador interno a 16MHz
    OSCCONbits.IRCF=0b111; //El ciclo de instruccion es de 0.25 us
    //Puertos como salida
    TRISB = 0x00;
    TRISC = 0x00;
    //Limpiamos puertos
    PORTB = 0x00;
    PORTC = 0x00;
}